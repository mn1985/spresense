## examples/gpio_control/Kconfig
```kconfig
config EXAMPLES_GPIO_CONTROL
	tristate "GPIO Control command"
	default n
	---help---
		Enable the gpio_control app.
		This can control any GPIO pins on Spresense board.

if EXAMPLES_GPIO_CONTROL

config EXAMPLES_GPIO_CONTROL_PROGNAME
	string "Program name"
	default "gpio_control"
	---help---
		This is the name of the program that will be use when the NSH ELF
		program is installed.

config EXAMPLES_GPIO_CONTROL_PRIORITY
	int "gpio_control task priority"
	default 100

config EXAMPLES_GPIO_CONTROL_STACKSIZE
	int "gpio_control stack size"
	default 2048

endif
```

## examples/stepperd/Kconfig
```kconfig
config EXAMPLES_STEPPERD
	tristate "Stepper Motor Daemon"
	default n
	---help---
		Enable the stepperd daemon.

if EXAMPLES_STEPPERD

config EXAMPLES_STEPPERD_PROGNAME
	string "Program name"
	default "stepperd"
	---help---
		This is the name of the program that will be use when the NSH ELF
		program is installed.

config EXAMPLES_STEPPERD_PRIORITY
	int "Task priority"
	default 100

config EXAMPLES_STEPPERD_STACKSIZE
	int "Stack size"
	default 2048

endif
```

## examples/stepping_motor/Kconfig
```kconfig
config EXAMPLES_STEPPING_MOTOR
	tristate "Stepping Motor Control"
	default n
	---help---
		Enable the stepping_motor app for DRV8835.

if EXAMPLES_STEPPING_MOTOR

config EXAMPLES_STEPPING_MOTOR_PROGNAME
	string "Program name"
	default "stepping_motor"
	---help---
		This is the name of the program that will be use when the NSH ELF
		program is installed.

config EXAMPLES_STEPPING_MOTOR_PRIORITY
	int "Task priority"
	default 100

config EXAMPLES_STEPPING_MOTOR_STACKSIZE
	int "Stack size"
	default 2048

endif
```

## examples/usb_cam_serial/Kconfig
```kconfig
config EXAMPLES_USB_CAM_SERIAL
	tristate "USB Camera Serial Transfer Example"
	default n
	---help---
		Enable the USB Camera Serial Transfer example

if EXAMPLES_USB_CAM_SERIAL

config EXAMPLES_USB_CAM_SERIAL_PROGNAME
	string "Program name"
	default "usb_cam_serial"
	---help---
		This is the name of the program that will be used when the NSH or
		sh runs this program.

config EXAMPLES_USB_CAM_SERIAL_PRIORITY
	int "Task priority"
	default 100

config EXAMPLES_USB_CAM_SERIAL_STACKSIZE
	int "Stack size"
	default 2048

endif
```

## sdk/configs/examples/stepperd/defconfig
```kconfig
CONFIG_EXAMPLES_STEPPERD=y
CONFIG_EXAMPLES_STEPPING_MOTOR=y
CONFIG_NSH_BUILTIN_APPS=y
```
